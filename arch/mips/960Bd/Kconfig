## arch/mips/960Bd/Kconfig
```kconfig
#
# Realtek Semiconductor Corp.
#
# 9601D/03D Platform Kernel Configuration
# MIPS_IAUP

if RTL9601D
	source "arch/mips/960Bd/config_rlx5281.in"
endif

if RTL9603D
	source "arch/mips/960Bd/config_mipsiaup.in"
endif

menu "9601D/03D Platform Configuration"
	comment "9601D/03D-only options start here"

	config ARCH_CACHE_L2C
		bool "Enable L2 Cache"

	comment "9601D/03D-only options end here"
endmenu
```

## arch/mips/Kconfig.formosa
```kconfig
#
# Realtek Semiconductor Corp.
#
# RLX Linux Kernel Configuration
#
# Tony Wu (tonywu@realtek.com)
# Dec. 07, 2008
#

source "formosa/config.top"
source "formosa/config.soc"

#
# MIPS
#
config SHEIPA
	bool
	default y
	select SYS_HAS_EARLY_PRINTK
	select CPU_SUPPORTS_32BIT_KERNEL
	select SYS_SUPPORTS_32BIT_KERNEL
	select SYS_SUPPORTS_LITTLE_ENDIAN if SOC_CPU_EL
	select SYS_SUPPORTS_BIG_ENDIAN if SOC_CPU_EB
	select IRQ_ICTL if SOC_ENABLE_ICTL
	select CPU_MIPSR2_IRQ_VI if SOC_ENABLE_IRQ_VI
	select CPU_MIPSR2_IRQ_EI if SOC_ENABLE_IRQ_EI
	select HW_HAS_PCI if SOC_ENABLE_PCI
	select HW_HAS_USB if SOC_ENABLE_USB
	select SMP if SOC_ENABLE_SMP
	select DMA_COHERENT if SOC_ENABLE_IOCU
	select DMA_NONCOHERENT if !SOC_ENABLE_IOCU
	select CPU_HAS_FPU if SOC_ENABLE_FPU
	select CPU_HAS_EMU if SOC_ENABLE_EMU
	select CPU_HAS_DSP if SOC_ENABLE_DSP
	select CPU_HAS_RADIAX if SOC_ENABLE_RADIAX
	select CPU_HAS_SLEEP if SOC_ENABLE_SLEEP
	select HARDWARE_WATCHPOINTS if SOC_ENABLE_WATCH
	select USE_OF if SOC_ENABLE_OF
	select CPU_HAS_AR7 if SOC_ENABLE_AR7
	select CPU_HAS_L2C if SOC_ENABLE_L2C
	select CPU_HAS_SPRAM if SOC_ENABLE_SPRAM
	select HAS_DMA

#
# CPU
#
config CPU_MIPS4K
	bool
	default y if SOC_CPU_MIPS4K

config CPU_MIPS24K
	bool
	default y if SOC_CPU_MIPS24K
	select CPU_HAS_TLS

config CPU_MIPS34K
	bool
	default y if SOC_CPU_MIPS34K
	select CPU_HAS_TLS
	select SYS_SUPPORTS_MULTITHREADING
	select SYS_SUPPORTS_SMP if SOC_ENABLE_MT
	select MIPS_MT_SMP if SOC_ENABLE_SMP

config CPU_MIPS74K
	bool
	default y if SOC_CPU_MIPS74K
	select CPU_HAS_TLS

config CPU_MIPS1004K
	bool
	default y if SOC_CPU_MIPS1004K
	select CPU_HAS_TLS
	select SYS_SUPPORTS_SMP
	select SYS_SUPPORTS_MULTITHREADING
	select SYS_SUPPORTS_MIPS_CMP
	select SYS_SUPPORTS_MIPS_CPS
	select IRQ_GIC
	select MIPS_CMP if SOC_ENABLE_CMP
	select MIPS_CPS if SOC_ENABLE_CPS
	select MIPS_MT_SMP if SOC_ENABLE_MT

config CPU_MIPS1074K
        bool
	default y if SOC_CPU_MIPS1074K
	select CPU_MIPS74K
	select SYS_SUPPORTS_SMP
	select SYS_SUPPORTS_MIPS_CMP
	select SYS_SUPPORTS_MIPS_CPS
	select IRQ_GIC
	select MIPS_CMP if SOC_ENABLE_CMP
	select MIPS_CPS if SOC_ENABLE_CPS

config CPU_RLX4181
	bool
	default y if SOC_CPU_RLX4181

config CPU_RLX5181
	bool
	default y if SOC_CPU_RLX5181
	select CPU_HAS_CLS

config CPU_RLX4281
	bool
	default y if SOC_CPU_RLX4281 || SOC_CPU_RLX4381
	default y if SOC_CPU_RLX4271 || SOC_CPU_RLX4371
	select CPU_HAS_TLS
	select CPU_HAS_WBIC
	select SYS_SUPPORTS_SMP if SOC_ENABLE_SMP
	select SYS_SUPPORTS_TAROKO_CMP if SOC_ENABLE_SMP
	select TAROKO_GIC if SOC_ENABLE_SMP
	select TAROKO_CMP if SOC_ENABLE_SMP

config CPU_RLX5281
	bool
	default y if SOC_CPU_RLX5281 || SOC_CPU_RLX5381
	default y if SOC_CPU_RLX5271 || SOC_CPU_RLX5371
	select CPU_HAS_CLS
	select CPU_HAS_TLS
	select CPU_HAS_WBIC
	select SYS_SUPPORTS_SMP if SOC_ENABLE_SMP
	select SYS_SUPPORTS_TAROKO_CMP if SOC_ENABLE_SMP
	select TAROKO_GIC if SOC_ENABLE_SMP
	select TAROKO_CMP if SOC_ENABLE_SMP

#
# CPU features
#
config CPU_HAS_DSP
	bool

config CPU_HAS_FPU
	bool

config CPU_HAS_EMU
	bool

config CPU_HAS_RADIAX
	bool

config CPU_HAS_SLEEP
	bool

config CPU_HAS_CLS
	bool

config CPU_HAS_TLS
	bool

config MIPS_FPU
	bool
	default y if CPU_HAS_FPU || CPU_HAS_EMU || CPU_HAS_MSA

#
# IRQ
#
config IRQ_ICTL
	bool

#
# CACHE
#
config CPU_HAS_SPRAM
	bool

config CPU_HAS_WBC
	bool
	default y

config CPU_HAS_L2C
	bool

config CPU_HAS_AR7
	bool

config CPU_HAS_WBIC
	bool

#
# BUS
#
config HW_HAS_USB
	bool
```

## arch/mips/Kconfig.rlx
```kconfig
#
# Realtek Semiconductor Corp.
#
# RLX Linux Kernel Configuration
#
# Tony Wu (tonywu@realtek.com)
# Dec. 07, 2008
#
source "arch/mips/config.in"

if RTK_RLX
	source "arch/rlx/config.rlx"
	source "arch/rlx/bsp_rtl8686/Kconfig"
endif

if RTL9607C
	source "arch/mips/config.mips"
	source "arch/mips/bsp_rtl9607c/Kconfig"
endif

if RTL9603D || RTL9601D
	source "arch/mips/960Bd/Kconfig"
endif

menu "CPU configuration"

comment "Select CPU features"

config CPU_ENABLE_FPU
	bool "Enable Taroko FPU support"
	default n
	depends on ARCH_CPU_FPU

config CPU_ENABLE_RADIAX
	bool "Enable RADIAX support"
	default n
	depends on ARCH_CPU_RADIAX

config CPU_ENABLE_TLS
	bool "Enable Taroko TLS support"
	default y
	depends on ARCH_CPU_TLS

config CPU_ENABLE_WMPU
	bool "Enable Taroko WMPU support"
	default n
	depends on ARCH_CPU_WMPU

endmenu

#
# RLX
#
config RLX
	bool
	default y
	select BOOT_ELF32
	select SYS_SUPPORTS_ARBIT_HZ
	select SYS_HAS_EARLY_PRINTK

config MACH_RLX
	bool
	default y if RTK_RLX
	select CPU_SUPPORTS_HIGHMEM
	select CPU_SUPPORTS_32BIT_KERNEL
	select SYS_SUPPORTS_32BIT_KERNEL
	select SYS_SUPPORTS_LITTLE_ENDIAN if ARCH_CPU_EL
	select SYS_SUPPORTS_BIG_ENDIAN if ARCH_CPU_EB
	select SYS_SUPPORTS_SMP if ARCH_CPU_SMP
	select SYS_SUPPORTS_CMP if ARCH_CPU_SMP
	select IRQ_CPU if ARCH_IRQ_CPU
	select IRQ_VEC if ARCH_IRQ_VEC
	select IRQ_GIC if ARCH_IRQ_GIC
	select HW_HAS_PCI if (ARCH_BUS_PCI && BSP_ENABLE_PCI)
	select HW_HAS_USB if (ARCH_BUS_USB && BSP_ENABLE_USB)
	select ARCH_SUPPORTS_MSI if (ARCH_BUS_PCI_MSI && BSP_ENABLE_PCI)
	select CPU_HAS_FPU if CPU_ENABLE_FPU
	select CPU_HAS_LLSC if ARCH_CPU_LLSC
	select CPU_HAS_RADIAX if CPU_ENABLE_RADIAX
	select CPU_HAS_SLEEP if ARCH_CPU_SLEEP
	select CPU_HAS_SYNC if ARCH_CPU_SYNC
	select CPU_HAS_TLS if CPU_ENABLE_TLS
	select CPU_HAS_ULS if ARCH_CPU_ULS
	select CPU_HAS_WMPU if CPU_ENABLE_WMPU
	select DMA_COHERENT if ARCH_CACHE_CAP
	select DMA_NONCOHERENT if !ARCH_CACHE_CAP

config MACH_MIPS
	bool
	default y if RTK_MIPS
	select SYS_HAS_EARLY_PRINTK
	select CPU_SUPPORTS_32BIT_KERNEL
	select SYS_SUPPORTS_32BIT_KERNEL
	select SYS_SUPPORTS_LITTLE_ENDIAN if SOC_CPU_EL
	select SYS_SUPPORTS_BIG_ENDIAN if SOC_CPU_EB
	select IRQ_ICTL if SOC_ENABLE_ICTL
	select CPU_MIPSR2_IRQ_VI if SOC_ENABLE_IRQ_VI
	select CPU_MIPSR2_IRQ_EI if SOC_ENABLE_IRQ_EI
	select HW_HAS_PCI if SOC_ENABLE_PCI
	select HW_HAS_USB if SOC_ENABLE_USB
	select SMP if SOC_ENABLE_SMP
	select DMA_COHERENT if SOC_ENABLE_IOCU
	select DMA_NONCOHERENT if !SOC_ENABLE_IOCU
	select CPU_HAS_FPU if SOC_ENABLE_FPU
	select CPU_HAS_EMU if SOC_ENABLE_EMU
	select CPU_HAS_DSP if SOC_ENABLE_DSP
	select CPU_HAS_RADIAX if SOC_ENABLE_RADIAX
	select CPU_HAS_SLEEP if SOC_ENABLE_SLEEP
	select HARDWARE_WATCHPOINTS if SOC_ENABLE_WATCH
	select USE_OF if SOC_ENABLE_OF
	select CPU_HAS_AR7 if SOC_ENABLE_AR7
	select CPU_HAS_L2C if SOC_ENABLE_L2C
	select CPU_HAS_SPRAM if SOC_ENABLE_SPRAM
	select HAS_DMA

#
# CPU
#
config CPU_RLX4181
	bool
	default y if ARCH_CPU_RLX4181

config CPU_RLX5181
	bool
	default y if ARCH_CPU_RLX5181
	select CPU_HAS_CLS

config CPU_RLX5280
	bool
	default y if ARCH_CPU_RLX5280
	select CPU_HAS_CLS

config CPU_RLX4281
	bool
	select CPU_HAS_BUS_ERROR
	default y if ARCH_CPU_RLX4281 || ARCH_CPU_RLX4381
	default y if ARCH_CPU_RLX4271 || ARCH_CPU_RLX4371

config CPU_RLX5281
	bool
	select CPU_HAS_BUS_ERROR
	default y if ARCH_CPU_RLX5281 || ARCH_CPU_RLX5381
	default y if ARCH_CPU_RLX5271 || ARCH_CPU_RLX5371
	select CPU_HAS_CLS

config CPU_MIPSIA
	bool
	default y if SOC_CPU_MIPSIA || SOC_CPU_MIPSIAUP
	select CPU_HAS_TLS
	select SYS_SUPPORTS_SMP
	select SYS_SUPPORTS_MULTITHREADING
	select SYS_SUPPORTS_MIPS_CMP
	select SYS_SUPPORTS_MIPS_CPS
	select IRQ_GIC if !SOC_CPU_MIPSIAUP
	select MIPS_CMP if SOC_ENABLE_CMP
	select MIPS_CPS if SOC_ENABLE_CPS

config CPU_HAS_RADIAX
	bool

config CPU_HAS_SLEEP
	bool

config CPU_HAS_CLS
	bool

config CPU_HAS_FPU
	bool

config CPU_HAS_LLSC
	bool

config CPU_HAS_ULS
	bool

config CPU_HAS_TLS
	bool

config CPU_HAS_LLSC
	bool

config CPU_HAS_BUS_ERROR
	bool

config CPU_HAS_WMPU
	bool
	select HARDWARE_WATCHPOINTS

	
config CPU_HAS_DSP
	bool

config CPU_HAS_FPU
	bool

config CPU_HAS_EMU
	bool


config CPU_HAS_TLS
	bool

config MIPS_FPU
	bool
	default y if CPU_HAS_FPU || CPU_HAS_EMU || CPU_HAS_MSA


#
# IRQ
#
config IRQ_VEC
	bool

#
# Timer
#
config CEVT_EXT
	bool
	default y if ARCH_CEVT_EXT
	default y if !CPU_RLX4281 && !CPU_RLX5281

config CEVT_RLX
	bool
	default y if ARCH_CEVT_RLX
	default n if !CPU_RLX4281 && !CPU_RLX5281

config CSRC_RLX
	bool
	default y if ARCH_CEVT_RLX
	default n if !CPU_RLX4281 && !CPU_RLX5281

#
# CACHE
#
config CPU_HAS_WBC
	bool
	default y if ARCH_CACHE_WBC

config CPU_HAS_L2C
	bool
	default y if ARCH_CACHE_L2C

config CPU_HAS_WBIC
	bool
	default y if ARCH_CACHE_WBIC

#
# BUS
#
config HW_HAS_USB
	bool

#
# MISC
#
#config USE_UAPI
#	bool
#	default y
#	help
#	  Starting Linux 3.7, UAPI is enabled.
```
